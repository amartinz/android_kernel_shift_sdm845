// SPDX-License-Identifier: GPL-2.0-only
/*
 * Copyright (c) 2017, The Linux Foundation. All rights reserved.
 */

//#include "shift/dsi-panel-shift-rm69299-amoled-1080x2160-cmd.dtsi"
#include "shift/dsi-panel-shift-rm69299-amoled-1080x2160-video.dtsi"

&dsi_shift6mq_rm69299_1080p_video {
	qcom,panel-supply-entries = <&dsi_panel_pwr_supply_no_labibb>;
	qcom,dsi-select-clocks = "mux_byte_clk0", "mux_pixel_clk0";
	qcom,mdss-dsi-bl-pmic-control-type = "bl_ctrl_dcs";
	qcom,mdss-dsi-bl-min-level = <1>;
	qcom,mdss-dsi-bl-max-level = <255>;
	qcom,mdss-dsi-mode-sel-gpio-state = "single_port";
};

&sde_dp {
	qcom,aux-sel-gpio = <&tlmm 49 0>;
};

&sde_dsi {
	qcom,dsi-default-panel = <&dsi_shift6mq_rm69299_1080p_video>;
	qcom,dsi-ctrl = <&mdss_dsi0>;
	qcom,dsi-phy = <&mdss_dsi_phy0>;
	clocks = <&mdss_dsi0_pll BYTECLK_MUX_0_CLK>,
		 <&mdss_dsi0_pll PCLK_MUX_0_CLK>;
	clock-names = "mux_byte_clk0", "mux_pixel_clk0";
	qcom,platform-en-gpio = <&tlmm 11 0>;
	qcom,platform-reset-gpio = <&tlmm 6 0>;

	/delete-property/ oled-vdda-supply;
};
